#include <Arduino.h>
#include "MySettings.h"
#include "SSD1306.h"
#include "SW.h"

/*SSD1306*/

Adafruit_SSD1306 display(SSD1306_WIDTH, SSD1306_HEIGH, &SSD1306_WIRE, -1); // displayを定義

const unsigned char LINEIRSWChecker_bitmap[] PROGMEM = {
    0x00, 0x00, 0x00, 0x00, 0x00, 0x00, 0x00, 0x00, 0x00, 0x00, 0x00, 0x00, 0x00, 0x00, 0x00, 0x00,
    0x00, 0xfc, 0x7c, 0xfc, 0x7c, 0xfc, 0xfc, 0x07, 0xe7, 0xcc, 0x6f, 0xcd, 0xfb, 0x3e, 0x63, 0x00,
    0x00, 0xfe, 0xfe, 0xfe, 0xfe, 0xfd, 0xfc, 0x0f, 0xef, 0xee, 0x6f, 0xed, 0xfb, 0x7f, 0x73, 0x00,
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    0x00, 0x00, 0x00, 0x00, 0x00, 0x00, 0x00, 0x00, 0x00, 0x00, 0x00, 0x00, 0x00, 0x00, 0x00, 0x00};

void SSD1306begin()
{
    while (!display.begin(SSD1306_SWITCHCAPVCC, SSD1306_ADRESS))
        ; // SSD1306と通信が確立するまで待つ
}

void SSD1306clear()
{
    // 画面初期化
    display.clearDisplay();
}

void SSD1306show()
{
    // 画面表示
    display.display();
}

void SSD1306write(int size, double ahead_x, double ahead_y, String Sentence, bool black)
{
    // テキスト表示
    display.setTextSize(size);
    if (!black)
    {
        display.setTextColor(SSD1306_WHITE, SSD1306_BLACK);
    }
    else
    {
        display.setTextColor(SSD1306_BLACK, SSD1306_WHITE);
    }
    display.setCursor(int(ahead_x), int(ahead_y));
    display.println(Sentence);
}

void SSD1306Bitmap(double x, double y, const unsigned char *bitmap, int width, int height, bool black)
{
    // ビットマップを表示
    if (!black)
    {
        display.drawBitmap(int(x), int(y), bitmap, width, height, SSD1306_WHITE);
    }
    else
    {
        display.drawBitmap(int(x), int(y), bitmap, width, height, SSD1306_BLACK);
    }
}

void SSD1306line(double start_x, double start_y, double end_x, double end_y, bool black)
{
    // ラインを描画
    if (!black)
    {
        display.drawLine(int(start_x), int(start_y), int(end_x), int(end_y), SSD1306_WHITE);
    }
    else
    {
        display.drawLine(int(start_x), int(start_y), int(end_x), int(end_y), SSD1306_BLACK);
    }
}

void SSD1306functionline(double origin_x, double origin_y, double a, double b, bool black)
{
    // 計算
    double start_x = 0;                                         // x = 0の時について
    double start_y = a * start_x - a * origin_x + b + origin_y; // x = 0の時のyを求める
    start_y = -start_y + SSD1306_HEIGH - 1;                     // 縦方向が正になるように調整
    double end_x = SSD1306_WIDTH - 1;                           // x = SSD1306_WIDTH - 1の時について
    double end_y = a * end_x - a * origin_x + b + origin_y;     // x = SSD1306_WIDTH - 1の時のyを求める
    end_y = -end_y + SSD1306_HEIGH - 1;                         // 縦方向が正になるように調整
    // ラインを描画
    if (!black)
    {
        display.drawLine(int(start_x), int(start_y), int(end_x), int(end_y), SSD1306_WHITE);
    }
    else
    {
        display.drawLine(int(start_x), int(start_y), int(end_x), int(end_y), SSD1306_BLACK);
    }
}

void SSD1306Circle(double point_x, double point_y, double circle_r, bool fill, bool black)
{
    // 円を描画
    if (!black)
    {
        if (fill)
        {
            display.fillCircle(int(point_x), int(point_y), int(circle_r), SSD1306_WHITE);
        }
        else
        {
            display.drawCircle(int(point_x), int(point_y), int(circle_r), SSD1306_WHITE);
        }
    }
    else
    {
        if (fill)
        {
            display.fillCircle(int(point_x), int(point_y), int(circle_r), SSD1306_BLACK);
        }
        else
        {
            display.drawCircle(int(point_x), int(point_y), int(circle_r), SSD1306_BLACK);
        }
    }
}

void SSD1306Rect(double topleft_x, double topleft_y, double width, double height, double corner_r, bool fill, bool black)
{
    // 矩形を描画
    if (!black)
    {
        if (fill)
        {
            display.fillRoundRect(int(topleft_x), int(topleft_y), int(width), int(height), int(corner_r), SSD1306_WHITE);
        }
        else
        {
            display.drawRoundRect(int(topleft_x), int(topleft_y), int(width), int(height), int(corner_r), SSD1306_WHITE);
        }
    }
    else
    {
        if (fill)
        {
            display.fillRoundRect(int(topleft_x), int(topleft_y), int(width), int(height), int(corner_r), SSD1306_BLACK);
        }
        else
        {
            display.drawRoundRect(int(topleft_x), int(topleft_y), int(width), int(height), int(corner_r), SSD1306_BLACK);
        }
    }
}

void SSD1306Triangle(double point1_x, double point1_y, double point2_x, double point2_y, double point3_x, double point3_y, bool fill, bool black)
{
    // 三角形を描画
    if (!black)
    {
        if (fill)
        {
            display.fillTriangle(int(point1_x), int(point1_y), int(point2_x), int(point2_y), int(point3_x), int(point3_y), SSD1306_WHITE);
        }
        else
        {
            display.drawTriangle(int(point1_x), int(point1_y), int(point2_x), int(point2_y), int(point3_x), int(point3_y), SSD1306_WHITE);
        }
    }
    else
    {
        if (fill)
        {
            display.fillTriangle(int(point1_x), int(point1_y), int(point2_x), int(point2_y), int(point3_x), int(point3_y), SSD1306_BLACK);
        }
        else
        {
            display.drawTriangle(int(point1_x), int(point1_y), int(point2_x), int(point2_y), int(point3_x), int(point3_y), SSD1306_BLACK);
        }
    }
}

/*SW*/

bool LeftSW = false;
bool RightSW = false;
bool EnterSW = false;
bool Old_LeftSW = false;
bool Old_RightSW = false;
bool Old_EnterSW = false;
bool LeftSW_true = false;
bool RightSW_true = false;
bool EnterSW_true = false;
bool BNO055resetSW = false;
bool MotorToggle = false;
bool CamToggle = false;

void SWbegin()
{
    // タクトスイッチのピンのピンモード設定
    pinMode(LEFTSWPIN, LEFTSWPINMODE);
    pinMode(RIGHTSWPIN, RIGHTSWPINMODE);
    pinMode(ENTERSWPIN, ENTERSWPINMODE);

    // トグルスイッチのピンのピンモード設定
    pinMode(MOTORTOGGLEPIN, INPUT);
    pinMode(CAMTOGGLEPIN, INPUT);
}

void TactSWget()
{
    // タクトスイッチの状態を取得
    if (LEFTSWPINMODE == INPUT_PULLUP)
    {
        if (Old_LeftSW)
        {
            // 前回押されているのならば、今回は押されていないこととする
            LeftSW = false;
        }
        else
        {
            // 前回押されていないので今の状況を格納する
            LeftSW = !digitalRead(LEFTSWPIN);
        }

        // タクトスイッチの状態を長押し対策なしで格納
        LeftSW_true = !digitalRead(LEFTSWPIN);
    }
    else
    {
        if (Old_LeftSW)
        {
            // 前回押されているのならば、今回は押されていないこととする
            LeftSW = false;
        }
        else
        {
            // 前回押されていないので今の状況を格納する
            LeftSW = digitalRead(LEFTSWPIN);
        }

        // タクトスイッチの状態を長押し対策なしで格納
        LeftSW_true = digitalRead(LEFTSWPIN);
    }

    if (RIGHTSWPINMODE == INPUT_PULLUP)
    {
        if (Old_RightSW)
        {
            // 前回押されているのならば、今回は押されていないこととする
            RightSW = false;
        }
        else
        {
            // 前回押されていないので今の状況を格納する
            RightSW = !digitalRead(RIGHTSWPIN);
        }

        // タクトスイッチの状態を長押し対策なしで格納
        RightSW_true = !digitalRead(RIGHTSWPIN);
    }
    else
    {
        if (Old_RightSW)
        {
            // 前回押されているのならば、今回は押されていないこととする
            RightSW = false;
        }
        else
        {
            // 前回押されていないので今の状況を格納する
            RightSW = digitalRead(RIGHTSWPIN);
        }

        // タクトスイッチの状態を長押し対策なしで格納
        RightSW_true = digitalRead(RIGHTSWPIN);
    }

    if (ENTERSWPINMODE == INPUT_PULLUP)
    {
        if (Old_EnterSW)
        {
            // 前回押されているのならば、今回は押されていないこととする
            EnterSW = false;
        }
        else
        {
            // 前回押されていないので今の状況を格納する
            EnterSW = !digitalRead(ENTERSWPIN);
        }

        // タクトスイッチの状態を長押し対策なしで格納
        EnterSW_true = !digitalRead(ENTERSWPIN);
    }
    else
    {
        if (Old_EnterSW)
        {
            // 前回押されているのならば、今回は押されていないこととする
            EnterSW = false;
        }
        else
        {
            // 前回押されていないので今の状況を格納する
            EnterSW = digitalRead(ENTERSWPIN);
        }

        // タクトスイッチの状態を長押し対策なしで格納
        EnterSW_true = digitalRead(ENTERSWPIN);
    }
    Old_LeftSW = LeftSW;   // 現在の状態を保存
    Old_RightSW = RightSW; // 現在の状態を保存
    Old_EnterSW = EnterSW; // 現在の状態を保存

    if (BNO055_RESETSWPINMODE == INPUT_PULLUP)
    {
        BNO055resetSW = !digitalRead(BNO055_RESETSWPIN);
    }
    else
    {
        BNO055resetSW = digitalRead(BNO055_RESETSWPIN);
    }

    // トグルスイッチの状態を取得
    MotorToggle = digitalRead(MOTORTOGGLEPIN);
    CamToggle = digitalRead(CAMTOGGLEPIN);
}