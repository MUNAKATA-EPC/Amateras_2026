//--------------------------------------------------------------------------------
// Title: Main - [ Gyro・Camのみ ]
// Build:DAISEN C-Style for TJ3B  [ Ver.20190706 ] - [ Build_V190617 ]
//--------------------------------------------------------------------------------
// SetupVal:111111-111130-010002,cmt:
// CN01:
// CN02:
// CN03:
// CN04:
// CN05:
// CN06:
// CN07:
// CN08:
// CN09:
// CN10:
//--------------------------------------------------------------------------------
#include "D_Main.h"
#include "D_I2C.h"
#include "D_SIO.h"
#include "D_EIO.h"
//--------------------------------------------------------------------------------
// Program Name : Gyro・Camのみ.C
//--------------------------------------------------------------------------------
void user_main(void)
{
  while (TRUE) {
    if (chk_pixydat_p(1, 0x0444)) {
      gPwm[0] = 0x14;
      gPwm[1] = 0x14;
      gPwm[2] = 0x14;
      gPwm[3] = 0x14;
      pwm_out();
    } else if (chk_pixydat_p(1, 0x0111)) {
      gPwm[0] = 0x14 | 0x80;
      gPwm[1] = 0x14 | 0x80;
      gPwm[2] = 0x14 | 0x80;
      gPwm[3] = 0x14 | 0x80;
      pwm_out();
    } else {
      gPwm[0] = 0x00 | 0x80;
      gPwm[1] = 0x00 | 0x80;
      gPwm[2] = 0x00 | 0x80;
      gPwm[3] = 0x00 | 0x80;
      pwm_out();
    }
  }
}
//--------------------------------------------------------------------------------
