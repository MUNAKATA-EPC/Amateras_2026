//--------------------------------------------------------------------------------
// Title: Main - [ ���� ]
// Build:DAISEN C-Style for TJ3B  [ Ver.20190706 ] - [ Build_V190617 ]
//--------------------------------------------------------------------------------
// SetupVal:111111-110010-012002,cmt:
// CN01:Ball
// CN02:Line
// CN03:L-Touch
// CN04:R-Touch
// CN05:C-Touch
// CN06:
// CN07:
// CN08:
// CN09:RED3
// CN10:RED2
//--------------------------------------------------------------------------------
#include "D_Main.h"
#include "D_I2C.h"
#include "D_SIO.h"
#include "D_EIO.h"
//--------------------------------------------------------------------------------
// Program Name : ����.C
//--------------------------------------------------------------------------------
void user_main(void)
{
  while (TRUE) {
    if (judge_bno(0, 100, 80)) {
      gPwm[0] = 0x14;
      gPwm[1] = 0x14;
      gPwm[2] = 0x14;
      gPwm[3] = 0x14;
      pwm_out();
    } else if (judge_bno(0, 260, 80)) {
      gPwm[0] = 0x14 | 0x80;
      gPwm[1] = 0x14 | 0x80;
      gPwm[2] = 0x14 | 0x80;
      gPwm[3] = 0x14 | 0x80;
      pwm_out();
    } else {
      if (gAD[CN1] < 30) {
        gPwm[0] = 0x14 | 0x80;
        gPwm[1] = 0x14;
        gPwm[2] = 0x14 | 0x80;
        gPwm[3] = 0x14;
        pwm_out();
      } else {
        gPwm[0] = 0x00 | 0x80;
        gPwm[1] = 0x00 | 0x80;
        gPwm[2] = 0x00 | 0x80;
        gPwm[3] = 0x00 | 0x80;
        pwm_out();
      }
    }
  }
}
//--------------------------------------------------------------------------------
